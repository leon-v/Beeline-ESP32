/*
Source code from https://github.com/yanbe/ssd1306-esp-idf-i2c
*/
#include <string.h>

#include "driver/gpio.h"
#include "driver/i2c.h"
#include "esp_err.h"
#include "esp_log.h"
#include "freertos/task.h"

#include "sdkconfig.h" // generated by "make menuconfig"

#include "ssd1306.h"
#include "font.h"

#define TAG "SSD1306"

#define I2C_TIMER 500 / portTICK_RATE_MS

static void ssd1306PinsInit() {

	#if (CONFIG_SSD1306_RST_ENABLE == 'y')
	gpio_config_t io_conf;

	io_conf.intr_type = GPIO_PIN_INTR_DISABLE; //disable interrupt
	io_conf.mode = GPIO_MODE_OUTPUT; //set as output mode
	io_conf.pin_bit_mask = (1ULL << CONFIG_SSD1306_RST_PIN) ;//bit mask of the pins that you want to set,e.g.GPIO18/19
	io_conf.pull_down_en = 0; //disable pull-down mode
	io_conf.pull_up_en = 1;//enable pull-up mode
	gpio_config(&io_conf);//configure GPIO with the given settings

	//This pin is reset signal input. When the pin is pulled LOW, initialization of the chip is
	//executed. Keep this pin HIGH (i.e. connect to VDD) during normal operation.
	gpio_set_level(CONFIG_SSD1306_RST_PIN, 1);

	#endif

	i2c_config_t i2c_config = {
		.mode = I2C_MODE_MASTER,
		.sda_io_num = CONFIG_SSD1306_SDA_PIN,
		.scl_io_num = CONFIG_SSD1306_SCL_PIN,
		.sda_pullup_en = GPIO_PULLUP_ENABLE,
		.scl_pullup_en = GPIO_PULLUP_ENABLE,
		.master.clk_speed = 1000000
	};

	i2c_param_config(I2C_NUM_0, &i2c_config);

	i2c_driver_install(I2C_NUM_0, I2C_MODE_MASTER, 0, 0, 0);

}

static esp_err_t ssd1306ModuleInit() {
	esp_err_t espRc;

	i2c_cmd_handle_t cmd = i2c_cmd_link_create();

	i2c_master_start(cmd);

	i2c_master_write_byte(cmd, OLED_I2C_WRITE, true);

	i2c_master_write_byte(cmd, OLED_CONTROL_BYTE_CMD_STREAM, true);
	i2c_master_write_byte(cmd, OLED_CMD_SET_CHARGE_PUMP, true);
	i2c_master_write_byte(cmd, 0x14, true);

	i2c_master_write_byte(cmd, OLED_CMD_DISPLAY_ON, true);

	// i2c_master_write_byte(cmd, OLED_CMD_SET_MUX_RATIO, true);
	// i2c_master_write_byte(cmd, 0x3F, true);

	// i2c_master_write_byte(cmd, OLED_CMD_SET_DISPLAY_OFFSET, true);
	// i2c_master_write_byte(cmd, 0x00, true);

	// i2c_master_write_byte(cmd, OLED_CMD_SET_DISPLAY_START_LINE | 0x00, true);

	i2c_master_write_byte(cmd, OLED_CONTROL_BYTE_CMD_SINGLE, true);
	i2c_master_write_byte(cmd, OLED_CMD_SET_SEGMENT_REMAP | 0x01, true);

	i2c_master_write_byte(cmd, OLED_CONTROL_BYTE_CMD_SINGLE, true);
	i2c_master_write_byte(cmd, OLED_CMD_SET_COM_SCAN_MODE | 0x08, true);

	// i2c_master_write_byte(cmd, OLED_CMD_SET_COM_PIN_MAP, true);
	// i2c_master_write_byte(cmd, 0x12, true);

	// i2c_master_write_byte(cmd, OLED_CMD_SET_CONTRAST, true);
	// i2c_master_write_byte(cmd, 0x7F, true);

	// i2c_master_write_byte(cmd, OLED_CMD_DISPLAY_RAM | 0x00, true);

	// i2c_master_write_byte(cmd, OLED_CMD_SET_MEMORY_ADDR_MODE, true);
	// i2c_master_write_byte(cmd, 0x02, true);

	// i2c_master_write_byte(cmd, OLED_CMD_SET_PAGE_RANGE, true);
	// i2c_master_write_byte(cmd, 0x00, true);
	// i2c_master_write_byte(cmd, 0x07, true);

	// i2c_master_write_byte(cmd, OLED_CMD_DISPLAY_NORMAL, true);

	// i2c_master_write_byte(cmd, OLED_CMD_SET_DISPLAY_CLK_DIV, true);
	// i2c_master_write_byte(cmd, 0x80, true);


	i2c_master_stop(cmd);

	espRc = i2c_master_cmd_begin(I2C_NUM_0, cmd, I2C_TIMER);

	if (espRc == ESP_OK) {
		ESP_LOGI(TAG, "OLED configured successfully");
	}

	else {
		ESP_LOGE(TAG, "OLED configuration failed. code: 0x%.2X", espRc);
	}

	i2c_cmd_link_delete(cmd);

	return espRc;
}

void ssd1306ClearLine(uint8_t line, uint8_t length) {

	uint8_t zero[128] = {0};
	// memset(zero, 0xAA, 128);

	i2c_cmd_handle_t cmd;

	cmd = i2c_cmd_link_create();
	ESP_ERROR_CHECK_WITHOUT_ABORT(i2c_master_start(cmd));

	ESP_ERROR_CHECK_WITHOUT_ABORT(i2c_master_write_byte(cmd, OLED_I2C_WRITE, true));

	ESP_ERROR_CHECK_WITHOUT_ABORT(i2c_master_write_byte(cmd, OLED_CONTROL_BYTE_DATA_STREAM, true));
	ESP_ERROR_CHECK_WITHOUT_ABORT(i2c_master_write(cmd, zero, 128 - length, true));

	ESP_ERROR_CHECK_WITHOUT_ABORT(i2c_master_stop(cmd));
	ESP_ERROR_CHECK_WITHOUT_ABORT(i2c_master_cmd_begin(I2C_NUM_0, cmd, I2C_TIMER));
	i2c_cmd_link_delete(cmd);
}

void ssd1306ClearScreen() {

	for (uint8_t i = 0; i < 8; i++) {

		i2c_cmd_handle_t cmd;

		cmd = i2c_cmd_link_create();

		ESP_ERROR_CHECK_WITHOUT_ABORT(i2c_master_start(cmd));
		ESP_ERROR_CHECK_WITHOUT_ABORT(i2c_master_write_byte(cmd, OLED_I2C_WRITE, true));

		ESP_ERROR_CHECK_WITHOUT_ABORT(i2c_master_write_byte(cmd, OLED_CONTROL_BYTE_CMD_SINGLE, true));
		ESP_ERROR_CHECK_WITHOUT_ABORT(i2c_master_write_byte(cmd, OLED_CMD_SET_PAGE | i, true));

		ESP_ERROR_CHECK_WITHOUT_ABORT(i2c_master_write_byte(cmd, OLED_CONTROL_BYTE_CMD_SINGLE, true));
		ESP_ERROR_CHECK_WITHOUT_ABORT(i2c_master_write_byte(cmd, OLED_CMD_SET_COLUMN_LOW	| 0x00, true)); // reset column

		ESP_ERROR_CHECK_WITHOUT_ABORT(i2c_master_write_byte(cmd, OLED_CONTROL_BYTE_CMD_SINGLE, true));
		ESP_ERROR_CHECK_WITHOUT_ABORT(i2c_master_write_byte(cmd, OLED_CMD_SET_COLUMN_HIGH | 0x00, true));

		ESP_ERROR_CHECK_WITHOUT_ABORT(i2c_master_stop(cmd));
		ESP_ERROR_CHECK_WITHOUT_ABORT(i2c_master_cmd_begin(I2C_NUM_0, cmd, I2C_TIMER));

		i2c_cmd_link_delete(cmd);

		ssd1306ClearLine(i, 0);
	}
}


void ssd1306SetPage(i2c_cmd_handle_t cmd, uint8_t page) {

	i2c_master_write_byte(cmd, OLED_CONTROL_BYTE_CMD_SINGLE, true);
	i2c_master_write_byte(cmd, OLED_CMD_SET_PAGE | page, true);
}
void ssd1306SetColumn(i2c_cmd_handle_t cmd, uint8_t column) {

	i2c_master_write_byte(cmd, OLED_CONTROL_BYTE_CMD_SINGLE, true);
	i2c_master_write_byte(cmd, OLED_CMD_SET_COLUMN_LOW	| ((column >> 0) & 0x0F), true);

	i2c_master_write_byte(cmd, OLED_CONTROL_BYTE_CMD_SINGLE, true);
	i2c_master_write_byte(cmd, OLED_CMD_SET_COLUMN_HIGH | ((column >> 4) & 0x0F), true);
}

void ssd1306SetPosition(i2c_cmd_handle_t cmd, uint8_t page, uint8_t column) {

	ESP_ERROR_CHECK_WITHOUT_ABORT(i2c_master_start(cmd));
	ESP_ERROR_CHECK_WITHOUT_ABORT(i2c_master_write_byte(cmd, OLED_I2C_WRITE, true));
	ESP_ERROR_CHECK_WITHOUT_ABORT(i2c_master_write_byte(cmd, OLED_CONTROL_BYTE_CMD_STREAM, true));

	ESP_ERROR_CHECK_WITHOUT_ABORT(i2c_master_write_byte(cmd, OLED_CMD_SET_PAGE			| page, true));
	ESP_ERROR_CHECK_WITHOUT_ABORT(i2c_master_write_byte(cmd, OLED_CMD_SET_COLUMN_LOW	| ((column >> 0) & 0x0F), true));
	ESP_ERROR_CHECK_WITHOUT_ABORT(i2c_master_write_byte(cmd, OLED_CMD_SET_COLUMN_HIGH	| ((column >> 4) & 0x0F), true));
}

void ssd1306SendString(i2c_cmd_handle_t cmd, char * string) {

	uint8_t length = strlen(string);
	uint8_t column = 0;

	ESP_ERROR_CHECK_WITHOUT_ABORT(i2c_master_start(cmd));
	ESP_ERROR_CHECK_WITHOUT_ABORT(i2c_master_write_byte(cmd, OLED_I2C_WRITE, true));
	ESP_ERROR_CHECK_WITHOUT_ABORT(i2c_master_write_byte(cmd, OLED_CONTROL_BYTE_DATA_STREAM, true));

	for (int i = 0; i < length; i++){
		uint8_t character = (uint8_t) string[i];
		ESP_ERROR_CHECK_WITHOUT_ABORT(i2c_master_write(cmd, font[character], FONT_WIDTH, true));
		column+= FONT_WIDTH;

		ESP_ERROR_CHECK_WITHOUT_ABORT(i2c_master_write_byte(cmd, 0x00, true));
		column++;
	}

	while (column < 128) {
		ESP_ERROR_CHECK_WITHOUT_ABORT(i2c_master_write(cmd, font[' '], FONT_WIDTH, true));
		column+= FONT_WIDTH;
	}
}

void ssd1306SetText(char * text) {

	i2c_cmd_handle_t cmd;
	cmd = i2c_cmd_link_create();

	uint8_t page = 0;

	char * line;

	line = strtok(text, "\r\n");

	while (line) {

		ssd1306SetPosition(cmd, page, 0);
		ssd1306SendString(cmd, line);

		line = strtok(NULL, "\r\n");
		page++;
	}

	while (page < 8) {
		ssd1306SetPosition(cmd, page, 0);
		ssd1306SendString(cmd, "");
		page++;
	}

	ESP_ERROR_CHECK_WITHOUT_ABORT(i2c_master_stop(cmd));
	ESP_ERROR_CHECK_WITHOUT_ABORT(i2c_master_cmd_begin(I2C_NUM_0, cmd, I2C_TIMER));
	i2c_cmd_link_delete(cmd);
}


esp_err_t ssd1306Init(void) {

	esp_err_t espRc;

	ssd1306PinsInit();

	vTaskDelay(I2C_TIMER);

	espRc = ssd1306ModuleInit();

	if (espRc != ESP_OK){
		return espRc;
	}

	vTaskDelay(I2C_TIMER);

	ssd1306ClearScreen();

	vTaskDelay(I2C_TIMER);

	return espRc;
}